## conf/layer.conf
```bitbake
# We have a conf and classes directory, append to BBPATH
BBPATH .= ":${LAYERDIR}"

# We have a recipes directory, add to BBFILES
BBFILES += "${LAYERDIR}/recipes*/*/*.bb \
	    ${LAYERDIR}/recipes*/*/*.bbappend"

BBFILE_COLLECTIONS += "meta-seacloud"
BBFILE_PATTERN_meta-seacloud := "^${LAYERDIR}/"
BBFILE_PRIORITY_meta-seacloud = "95"

# For not standard licenses
LICENSE_PATH += "${LAYERDIR}/licenses"

LAYERSERIES_COMPAT_meta-seacloud = "sumo thud warrior"
```
